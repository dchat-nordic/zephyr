## dts/bindings/sensor/bosch,bmi270.yaml
```yaml
# Copyright (c) 2022, Nordic Semiconductor ASA
# SPDX-License-Identifier: Apache-2.0

description: |
    The BMI270 is an inertial measurment unit. See more info at:
    https://www.bosch-sensortec.com/products/motion-sensors/imus/bmi270.html

compatible: "bosch,bmi270"
```
